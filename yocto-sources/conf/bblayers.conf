## yocto-sources/conf/bblayers.conf
```bitbake
# POKY_BBLAYERS_CONF_VERSION is increased each time build/conf/bblayers.conf
# changes incompatibly
POKY_BBLAYERS_CONF_VERSION = "2"

BBPATH = "${TOPDIR}"
BBFILES ?= ""

BBLAYERS ?= " \
  /home/docker/poky/meta \
  /home/docker/poky/meta-poky \
  /home/docker/poky/meta-yocto-bsp \
  /home/docker/meta-openembedded/meta-oe \
  /home/docker/meta-openembedded/meta-python \
  /home/docker/meta-openembedded/meta-networking \
  /home/docker/meta-openembedded/meta-webserver \
  /home/docker/meta-cfecfs \
  "
```

## yocto-sources/meta-cfecfs/conf/layer.conf
```bitbake
# We have a conf and classes directory, add to BBPATH
BBPATH .= ":${LAYERDIR}"

LAYERSERIES_COMPAT_cfecfs = "kirkstone scarthgap walnascar"

# We have recipe directories, add to BBFILES
BBFILES += "${LAYERDIR}/recipes/*/*.bb \
            ${LAYERDIR}/recipes/*/*.bbappend \ 
            ${LAYERDIR}/images/*.bb \
            ${LAYERDIR}/images/*.bbappend "

BBFILE_COLLECTIONS += "cfecfs"
BBFILE_PATTERN_cfecfs = "^${LAYERDIR}/"
BBFILE_PRIORITY_cfecfs = "7"
LAYERVERSION_cfecfs = "1"
```
